## config/boards/shields/Pyuron/Kconfig.shield
```kconfig
config SHIELD_ORBEE_R
    def_bool $(shields_list_contains,Pyuron_R)

config SHIELD_ORBEE_L
    def_bool $(shields_list_contains,Pyuron_L)
```

## config/west.yml
```yaml
manifest:
  remotes:
    - name: zmkfirmware 
      url-base: https://github.com/zmkfirmware
    - name: MeowCatpawkittie
      url-base: https://github.com/MeowCatpawkittie
    - name: caksoylar
      url-base: https://github.com/caksoylar  
    - name: badjeff
      url-base: https://github.com/badjeff
    - name: zettaface
      url-base: https://github.com/zettaface
    - name: yuitumunii
      url-base: https://github.com/yuitumunii
  projects:
    # 自前fork: cormoran custom-studio-protocol ベース + Pyuronの1行修正
    # (filter_with_input_config がレイヤーオーバーライドのSTOPを尊重 →
    #  トラックボールのカーソル漏れ解消)。custom-studio-protocol はカスタム
    #  Studio RPC サブシステム(ジェスチャーのライブ調整)の土台。
    #  ※従来の pyuron-input-stop-fix は本家main+1行修正のみ(カスタムRPC無し)。
    - name: zmk
      remote: yuitumunii
      revision: pyuron+custom-studio+split-cpi
      import: app/west.yml
    - name: zmk-pmw3610-driver
      remote: yuitumunii
      revision: live-cpi
    - name: zmk-rgbled-widget
      remote: caksoylar
      revision: main
    # 自前fork: tick/wait-ms 等をRAM化 + カスタムStudio RPC(pyuron_gesture)で
    # ジェスチャー感度をライブ調整(焼かずに変更)。要 custom-studio-protocol 土台 +
    # conf の CONFIG_ZMK_INPUT_PROCESSOR_KEYBIND_STUDIO_RPC=y。
    - name: zmk-input-processor-keybind
      remote: yuitumunii
      revision: a6ba7fc
  self:
    path: config
```
